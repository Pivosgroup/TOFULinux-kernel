## drivers/amlogic/dvb_tv/Kconfig
```kconfig
#
# Smart card driver configuration
#

menu "AMLOGIC DVB driver"

config AM_DVB
	tristate "AMLOGIC DVB driver"
	default n
	select DVB_CORE
	help
		Select to enable AMLogic DVB driver.

menu "AMLOGIC CI Driver"

config AM_CI
	tristate "Amlogic Common Interface driver"
	default n
	depends on AM_DVB
	select AM_PCMCIA
	select AM_IOBUS
	help
		Select to enable Amlogic CI driver.

config AM_PCMCIA
	tristate "Amlogic PCMCIA driver"
	default n
	help
		Select to enable Amlogic PCMCIA driver.
	
config AM_IOBUS
	tristate "Amlogic IOBUS driver"
	default n
	help
		Select to enable Amlogic IOBUS driver.

endmenu

config AMLOGIC_DYNAMIC_FEANDDMX_CONFIG
	bool "Support Dynamic Frontend And Demux Config"
	default n
	depends on AM_DVB
	help
		Support dynamic frontend and demux config.

if !AMLOGIC_DYNAMIC_FEANDDMX_CONFIG

config AMLOGIC_TS0
	bool "Enable TS0"
	default n
	depends on AM_DVB
	help
		Enable TS0.

config AMLOGIC_S_TS0
	bool "Serial TS0"
	default n
	depends on AMLOGIC_TS0
	help
		TS0 in serial mode.

config AMLOGIC_TS0_INVERT_S2P1_FEC_ERROR
	bool "Invert FEC_ERROR TS0"
	default n
	depends on AMLOGIC_S_TS0
	help
		TS0 FEC_ERROR invert

config AMLOGIC_TS0_INVERT_S2P1_FEC_DATA
	bool "Invert FEC_DATA TS0"
	default n
	depends on AMLOGIC_S_TS0
	help
		TS0 FEC_DATA invert

config AMLOGIC_TS0_INVERT_S2P1_FEC_SYNC
	bool "Invert FEC_SYNC TS0"
	default n
	depends on AMLOGIC_S_TS0
	help
		TS0 FEC_SYNC invert

config AMLOGIC_TS0_INVERT_S2P1_FEC_VALID
	bool "Invert FEC_VALID TS0"
	default n
	depends on AMLOGIC_S_TS0
	help
		TS0 FEC_VALID invert

config AMLOGIC_TS0_INVERT_S2P1_FEC_CLK
	bool "Invert FEC_CLK TS0"
	default n
	depends on AMLOGIC_S_TS0
	help
		TS0 FEC_CLK invert

config AMLOGIC_TS1
	bool "Enable TS1"
	default n
	depends on AM_DVB
	help
		Enable TS1.

config AMLOGIC_S_TS1
	bool "Serial TS1"
	default n
	depends on AMLOGIC_TS1
	help
		TS1 in serial mode.

config AMLOGIC_TS1_INVERT_S2P1_FEC_ERROR
	bool "Invert FEC_ERROR TS1"
	default n
	depends on AMLOGIC_S_TS1
	help
		TS1 FEC_ERROR invert

config AMLOGIC_TS1_INVERT_S2P1_FEC_DATA
	bool "Invert FEC_DATA TS1"
	default n
	depends on AMLOGIC_S_TS1
	help
		TS1 FEC_DATA invert

config AMLOGIC_TS1_INVERT_S2P1_FEC_SYNC
	bool "Invert FEC_SYNC TS1"
	default n
	depends on AMLOGIC_S_TS1
	help
		TS1 FEC_SYNC invert

config AMLOGIC_TS1_INVERT_S2P1_FEC_VALID
	bool "Invert FEC_VALID TS1"
	default n
	depends on AMLOGIC_S_TS1
	help
		TS1 FEC_VALID invert

config AMLOGIC_TS1_INVERT_S2P1_FEC_CLK
	bool "Invert FEC_CLK TS1"
	default n
	depends on AMLOGIC_S_TS1
	help
		TS1 FEC_CLK invert

config AMLOGIC_TS2
	bool "Enable TS2"
	default n
	depends on AM_DVB
	help
		Enable TS2.

config AMLOGIC_S_TS2
	bool "Serial TS2"
	default n
	depends on AMLOGIC_TS2
	help
		TS2 in serial mode.

config AMLOGIC_TS2_INVERT_S2P1_FEC_ERROR
	bool "Invert FEC_ERROR TS2"
	default n
	depends on AMLOGIC_S_TS2
	help
		TS2 FEC_ERROR invert

config AMLOGIC_TS2_INVERT_S2P1_FEC_DATA
	bool "Invert FEC_DATA TS2"
	default n
	depends on AMLOGIC_S_TS2
	help
		TS2 FEC_DATA invert

config AMLOGIC_TS2_INVERT_S2P1_FEC_SYNC
	bool "Invert FEC_SYNC TS2"
	default n
	depends on AMLOGIC_S_TS2
	help
		TS2 FEC_SYNC invert

config AMLOGIC_TS2_INVERT_S2P1_FEC_VALID
	bool "Invert FEC_VALID TS2"
	default n
	depends on AMLOGIC_S_TS2
	help
		TS2 FEC_VALID invert

config AMLOGIC_TS2_INVERT_S2P1_FEC_CLK
	bool "Invert FEC_CLK TS2"
	default n
	depends on AMLOGIC_S_TS2
	help
		TS2 FEC_CLK invert

config AM_MXL101
	tristate "MXL101 demod driver"
	default n
	depends on AM_DVB
	help
		Select to enable MXL101(dvbt) demod driver.

config AM_AVL6211
	tristate "AVL6211 demod driver"
	default n
	depends on AM_DVB
	help
		Select to enable AVL6211(dvbs2) demod driver.	
		
config AM_SI2168
	tristate "SI2168 demod driver"
	default n
	depends on AM_DVB
	help
		Select to enable SI2168(dvbt,dvbt2) demod driver.	
		
config AM_ITE9133
	tristate "ITE9133 demod driver"
	default n
	depends on AM_DVB
	help
		Select to enable ITE9133(dvbt) demod driver.	
		
config AM_ITE9173
	tristate "ITE9173 demod driver"
	default n
	depends on AM_DVB
	help
		Select to enable ITE9173(isdbt) demod driver.	
		
config AM_M6_DEMOD
	tristate "M6 demod driver"
	default y
	depends on AM_DVB
	help
		Select to enable M6 demod driver.

config AM_SI2176
    tristate "SI2176 tuner driver"
    default n
    depends on AM_DVB
	help
		Select to enable SI2176 driver.
config AM_SI2196
    tristate "SI2196 tuner driver"
    default n
    depends on AM_DVB
	help
		Select to enable SI2196 driver.
config AM_CTC703
	tristate "CRESTA tuner driver"
	default n
	depends on AM_DVB
	help
		select the cresta tuner.		

endif

if AMLOGIC_DYNAMIC_FEANDDMX_CONFIG

config AM_MXL101
	tristate "MXL101 demod driver"
	default y
	depends on AM_DVB
	help
		Select to enable MXL101(dvbt) demod driver.

config AM_AVL6211
	tristate "AVL6211 demod driver"
	default y
	depends on AM_DVB
	help
		Select to enable AVL6211(dvbs2) demod driver.	
		
config AM_SI2168
	tristate "SI2168 demod driver"
	default y
	depends on AM_DVB
	help
		Select to enable SI2168(dvbt,dvbt2) demod driver.	
		
config AM_M6_DEMOD
	tristate "M6 demod driver"
	default y
	depends on AM_DVB
	help
		Select to enable M6 demod driver.
		
config AM_ITE9133
	tristate "ITE9133 demod driver"
	default n
	depends on AM_DVB
	help
		Select to enable ITE9133(dvbt) demod driver.	
		
config AM_ITE9173
	tristate "ITE9173 demod driver"
	default n
	depends on AM_DVB
	help
		Select to enable ITE9173(isdbt) demod driver.	

config AM_SI2176
    tristate "SI2176 tuner driver"
    default y
    depends on AM_DVB
	help
		Select to enable SI2176 driver.
config AM_SI2196
    tristate "SI2196 tuner driver"
    default y
    depends on AM_DVB
	help
		Select to enable SI2196 driver.
config AM_CTC703
	tristate "CRESTA tuner driver"
	default y
	depends on AM_DVB
	help
		select the cresta tuner.	

endif
		
endmenu
```

## drivers/amlogic/ebsecure/Kconfig
```kconfig
#
# Amlogic efuse device configuration
#

menu "Amlogic eb secure Support"

config EB_SECURE
	bool "eb secure Driver"
	default n
	help
		eb secure is a rsa encrypt/decrypt lib,it used for safety

endmenu
```

## drivers/amlogic/hdmi/Kconfig
```kconfig
menu "Amlogic HDMI TX Support"


config AML_HDMI_TX
        bool "HDMI Output Enable"
        default y
        select SWITCH
        select AM_DISPLAY_MODULE
        help  
                hdmi output enable,It should be enalbe if board have hdmi out interface

config AML_HDMI_TX_CEC_SW
        bool "HDMI CEC Software Enable"
        default n
        help  
                hdmi cec software enable, default is hardware mode
                
endmenu
```

## drivers/amlogic/input/saradc/Kconfig
```kconfig
#
# Input core configuration
#
config SARADC_AM
	bool "Meson SAR ADC support"
	default n
	help
	  Say Y here if you want to use the Meson SAR ADC.

config TEMPERATURE_SENSOR_GOVERNOR
    bool "Meson temperature sensor governor"
    select SARADC_AM
    default n
    help
        This config will eanble temperature sensor value of IC feed back to
        CPU frequent governor.
```

## drivers/amlogic/spi_nor/Kconfig
```kconfig
#
# Sensor device configuration
#

menu "AMLOGIC SPI NOR Flash  support"


config AMLOGIC_SPI_NOR
	tristate "AMLOGIC SPI NOR FLASH SUPPORT"
  select MTD
  select MTD_DATA_FLASH 
  select MTD_PARTITIONS
  select MTD_BLOCK
  select MTD_CHAR
  select SPI
	help
		This is amlogic spi nor suport
		This driver can also be built as a module.  If so, the module
		will be called apollo_nand.ko
	  
config SPI_NOR_SECURE_STORAGE
	bool "amlogic spi nor flash secure storage support "
	depends on AMLOGIC_SPI_NOR
	default n
	help
		config amlogic spi nor flash secure storage 

config SPI_SECURE_STORAGE_TEST
	bool "test secure storage"
	depends on SPI_NOR_SECURE_STORAGE
	default n
	help
		test spi secure storage
endmenu
```

## drivers/amlogic/vresourcesvr/Kconfig
```kconfig
#
# Video Resource Manager
#

menu "Video Resource Manager"
config AML_VIDEO_RES_MGR
	bool "Amlogic Video Resource Manager"
	default n
	help
		For Future use of multiinstance video playing. Now It can provide
		Frame to user spaces.
endmenu
```
